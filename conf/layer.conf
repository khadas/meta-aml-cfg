## conf/layer.conf
```bitbake
BBPATH .= ":${LAYERDIR}"

# We have a recipes-* directories, add to BBFILES
BBFILES += "${LAYERDIR}/recipes-*/*/*.bb \
	${LAYERDIR}/recipes-*/*/*.bbappend \
        ${LAYERDIR}/recipes-*/*/*/*.bbappend \
        ${LAYERDIR}/recipes-*/*.bb"

BBFILE_COLLECTIONS += "aml-cfg"
BBFILE_PATTERN_aml-cfg := "^${LAYERDIR}/"
BBFILE_PRIORITY_aml-cfg = "7"

# license directories.
LICENSE_PATH += "${LAYERDIR}/licenses"

# aml-apps related feature control support.
LAYERSERIES_COMPAT_aml-cfg = "dunfell kirkstone"
```

## conf/machine/include/amlogic_aiot_common.inc
```bitbake
#@TYPE: Machine
#@NAME: meson

#@DESCRIPTION: Machine configuration for meson AIOT systems

CONNECTIVITY_CHECK_URIS = "https://www.yoctoproject.org/"


RDEPENDS:packagegroup-amlogic-baserootfs:remove = " aml-subtitleserver"
RDEPENDS:packagegroup-amlogic-baserootfs:remove = " gst-aml-drm-plugins"
RDEPENDS:packagegroup-amlogic-baserootfs:remove = " gst-agmplayer"
RDEPENDS:packagegroup-amlogic-baserootfs:remove = " fuse-exfat"

KERNEL_MODULE_AUTOLOAD += " meson_ir"
KERNEL_MODULE_AUTOLOAD += " hci_uart"
KERNEL_MODULE_PROBECONF += "hci_uart"
KERNEL_MODULE_AUTOLOAD += "meson-cpufreq"

DISTRO_FEATURES_BACKFILL_CONSIDERED = "sysvinit"
DEFAULT_DISTRO_FEATURES += " systemd"
DISTRO_FEATURES:append = " systemd"
DISTRO_FEATURES:remove = " sysvinit"
DISTRO_FEATURES:append = " gstreamer1"

DISTRO_FEATURES:append = " recovery"
DISTRO_FEATURES:append = " swupdate"

DISTRO_FEATURES:append = " aml-libgdc"
DISTRO_FEATURES:append = " secure-u-boot optee "
DISTRO_FEATURES:append = " alsa "
DISTRO_FEATURES:append = " pam"
#DISTRO_FEATURES:append = " aml-dtv "
DISTRO_FEATURES:append = " drm"

DISTRO_FEATURES:append = " gst-aml-gfx2d"
DISTRO_FEATURES:append = " dma-allocator"
DISTRO_FEATURES:append = " gst-aml-dma-allocator"
DISTRO_FEATURES:append = " gst-plugin-conv"
DISTRO_FEATURES:append = " aml-screencapture"
DISTRO_FEATURES:append = " aml-test"

DISTRO_FEATURES:append = " mediactrlsrc"
```

## conf/machine/include/amlogic_aiot_nndemo.inc
```bitbake
#@TYPE: Machine
#@NAME: meson

#@DESCRIPTION: Machine configuration for meson AIOT NN relative systems

DISTRO_FEATURES:append = " gst-jpeg-swdec"
DISTRO_FEATURES:append = " gst-plugin-overlay"
DISTRO_FEATURES:append = " gst-plugin-nn"
DISTRO_FEATURES:append = " detect-library"
DISTRO_FEATURES:append = " detect-sample"
DISTRO_FEATURES:append = " nndemo-library"
```

## conf/machine/include/amlogic_debian_common.inc
```bitbake
#@TYPE: Machine
#@NAME: meson

#@DESCRIPTION: Machine configuration for meson debian OS systems

DISTRO_FEATURES:append = " amlbian"
DISTRO_FEATURES:append = " nfs-boot"

# clear linux version extension information, keep original
LINUX_VERSION_EXTENSION ?= ""

#for debian, needn't build uboot in yocto, will be build in amlbian,
EXTRA_IMAGEDEPENDS:remove = "u-boot"
DISTRO_FEATURES:remove = "u-boot"
```

## conf/machine/include/amlogic_enc_common.inc
```bitbake
#@TYPE: Machine
#@NAME: meson

#@DESCRIPTION: Machine configuration for encoder

DISTRO_FEATURES:append = " gst-plugin-venc"
DISTRO_FEATURES:append = " gst-aml-videotranscoding"
DISTRO_FEATURES:append = " videotranscoding-demo "
```

## conf/machine/include/amlogic_nnstreamer.inc
```bitbake
#@TYPE: Machine
#@NAME: meson

#@DESCRIPTION: Machine configuration for nnstreamer

#DISTRO_FEATURES:append = " nnstreamer"
#DISTRO_FEATURES:append = " nnstreamer-example"
#DISTRO_FEATURES:append = " tensorflow-lite"
PREFERRED_VERSION_tensorflow-lite = "2.6.0"
```

## conf/machine/include/amlogic_weston.inc
```bitbake
#For Weston
DISTRO_FEATURES:append = " weston wayland weston-init"
PREFERRED_VERSION_weston = "10.0.0"
DISTRO_FEATURES:remove = " mesa mesa-gl x11"
DISTRO_FEATURES:remove = " amazon-plugin cobalt netflix selinux"
DISTRO_FEATURES:append = " dual_display"

#Remove netflix related
RDEPENDS:packagegroup-amlogic-baserootfs:remove = "netflix-aml wpeframework-plugin-netflix"
#Remove thunder framework related
RDEPENDS:packagegroup-amlogic-baserootfs:remove = "bluetooth-mgr bluetooth-core"
RDEPENDS:packagegroup-amlogic-baserootfs:append = "sshfs-fuse"
```

## conf/machine/mesong12b-kvim3-k5.15.conf
```bitbake
include conf/machine/include/mesong12b_k5.15_64b.inc
include conf/machine/mesong12b-kvim3-common.inc
```

## conf/machine/mesong12b-w400-k5.15.conf
```bitbake
include conf/machine/include/mesong12b_k5.15_64b.inc
include conf/machine/mesong12b-w400-common.inc
```

## conf/machine/mesongsm1-kvim3l-common.inc
```bitbake
#@TYPE: Machine
#@NAME: meson

#@DESCRIPTION: Machine configuration for meson systems

include conf/machine/include/amlogic_weston.inc
include conf/machine/include/amlogic_aiot_common.inc
include conf/machine/include/amlogic_aiot_nndemo.inc
include conf/machine/include/amlogic_enc_common.inc

require conf/machine/include/amlogic_dvalin.inc

MACHINE_EXTRA_RRECOMMENDS += " \
        gpu \
        wififw-ap6398 \
        ap6xxx \
        npu \
        coreutils \
        "

RDEPENDS:packagegroup-amlogic-baserootfs:append = " npu-common"

BOARD_NAME = "vim3l"
CHIPSET_NAME = "S905D3"
KERNEL_DEVICETREE = "sm1_kvim3l.dtb"
UBOOT_MACHINE = " kvim3l_config"
KERNEL_MODULE_AUTOLOAD += " dhd"
KERNEL_MODULE_PROBECONF += "dhd"
module_conf_dhd = "options dhd firmware_path=../../etc/wifi/6398/ nvram_path=../../etc/wifi/6398/"
KERNEL_MODULE_AUTOLOAD += " snd-soc-dummy_codec"
KERNEL_MODULE_AUTOLOAD += " snd-soc-aml_t9015"
KERNEL_MODULE_AUTOLOAD += " snd-soc-tas5707"
KERNEL_MODULE_AUTOLOAD += " snd-soc-aml_codec_tl1_acodec"

DISTRO_FEATURES:append = " aml-libjpeg"
DISTRO_FEATURES:append = " aml-libamvenc-264"
DISTRO_FEATURES:append = " aml-libamvenc-265"
DISTRO_FEATURES:append = " aml-libamvenc"
DISTRO_FEATURES:append = " softap"

DISTRO_FEATURES:append = " mediactrlsrc-hdmi"

OVERRIDES .= ":ac200:sm1:onepass"
MACHINEOVERRIDES .= ":client"

DISTRO_FEATURES:append = " bt-bcm"
EXTRA_BLUETOOTH_STUFF := "${@bb.utils.contains('DISTRO_FEATURES', 'bluetooth', bb.utils.contains('DISTRO_FEATURES', 'bluez5', ' bluez5', ' bluez4', d), '', d)}"
EXTRA_BLUETOOTH_STUFF += " bluez-alsa"
EXTRA_BLUETOOTH_STUFF += " brcm-patchram-plus"
DISTRO_FEATURES:append = "${EXTRA_BLUETOOTH_STUFF}"
```

## conf/machine/mesongsm1-kvim3l-k5.15.conf
```bitbake
include conf/machine/include/mesonsm1_k5.15_64b.inc
include conf/machine/mesongsm1-kvim3l-common.inc
```

## conf/machine/mesons4-ap222-common.inc
```bitbake
#@TYPE: Machine
#@NAME: meson

#@DESCRIPTION: Machine configuration for meson systems

include conf/machine/include/amlogic_weston.inc
include conf/machine/include/amlogic_aiot_common.inc

require conf/machine/include/amlogic_dvalin.inc

MACHINE_EXTRA_RRECOMMENDS += " \
        gpu \
        wififw-qca6174 \
        qca6174 \
        aucpu-fw \
        coreutils \
        "

CHIPSET_NAME = "S905Y4"
KERNEL_DEVICETREE = "s4_s905y4_ap222_linux.dtb"
UBOOT_MACHINE = "s4_ap222_config"
KERNEL_MODULE_AUTOLOAD += " btqca"
KERNEL_MODULE_PROBECONF += "btqca"
KERNEL_MODULE_AUTOLOAD += " snd-soc-dummy_codec"
KERNEL_MODULE_AUTOLOAD += " snd-soc-aml_t9015"
KERNEL_MODULE_AUTOLOAD += "aml_aucpu"
KERNEL_MODULE_AUTOLOAD += " media_sync"

DISTRO_FEATURES:append = " gpt-partition"
DISTRO_FEATURES:append = " kernel_515"

OVERRIDES .= ":ap222:s4:onepass"
MACHINEOVERRIDES .= ":client"

DISTRO_FEATURES:append = " bt-qca"
EXTRA_BLUETOOTH_STUFF := "${@bb.utils.contains('DISTRO_FEATURES', 'bluetooth', bb.utils.contains('DISTRO_FEATURES', 'bluez5', ' bluez5', ' bluez4', d), '', d)}"
EXTRA_BLUETOOTH_STUFF += " bluez-alsa"
DISTRO_FEATURES:append = "${EXTRA_BLUETOOTH_STUFF}"
```

## conf/machine/mesons4-kvim1s-5.15.conf
```bitbake
include conf/machine/include/mesons4_k5.15_64b.inc
include conf/machine/mesons4-kvim1s-5.15.inc
```

## conf/machine/mesons4-kvim1s-5.15.inc
```bitbake
#@TYPE: Machine
#@NAME: meson

#@DESCRIPTION: Machine configuration for meson systems

include conf/machine/include/amlogic_weston.inc
include conf/machine/include/amlogic_aiot_common.inc

require conf/machine/include/amlogic_dvalin.inc

MACHINE_EXTRA_RRECOMMENDS += " \
        gpu \
        wififw-ap6256 \
        ap6xxx \
        aucpu-fw \
        coreutils \
        "

RDEPENDS:packagegroup-amlogic-baserootfs:append = " khadas-custom"
RDEPENDS:packagegroup-amlogic-baserootfs:append = " brcm-patchram-plus "

BOARD_NAME = "vim1s"
CHIPSET_NAME = "S905Y4"
KERNEL_DEVICETREE = "s4_kvim1s.dtb"
UBOOT_MACHINE = "s4_kvim1s_config"
KERNEL_MODULE_AUTOLOAD += " dhd"
KERNEL_MODULE_PROBECONF += "dhd"
module_conf_dhd = "options dhd firmware_path=../../etc/wifi/6256/ nvram_path=../../etc/wifi/6256/nvram_ap6256.txt"
KERNEL_MODULE_AUTOLOAD += " snd-soc-dummy_codec"
KERNEL_MODULE_AUTOLOAD += " snd-soc-aml_t9015"
KERNEL_MODULE_AUTOLOAD += "aml_aucpu"
KERNEL_MODULE_AUTOLOAD += " media_sync"

DISTRO_FEATURES:append = " gpt-partition"
DISTRO_FEATURES:append = " kernel_515"

OVERRIDES .= ":ap222:s4:onepass"
MACHINEOVERRIDES .= ":client"

DISTRO_FEATURES:append = " bt-bcm"
EXTRA_BLUETOOTH_STUFF := "${@bb.utils.contains('DISTRO_FEATURES', 'bluetooth', bb.utils.contains('DISTRO_FEATURES', 'bluez5', ' bluez5', ' bluez4', d), '', d)}"
EXTRA_BLUETOOTH_STUFF += " bluez-alsa"
DISTRO_FEATURES:append = "${EXTRA_BLUETOOTH_STUFF}"

DISTRO_FEATURES:append = " wififw "
```

## conf/machine/mesonsc2-ah212-common.inc
```bitbake
#@TYPE: Machine
#@NAME: meson

#@DESCRIPTION: Machine configuration for meson systems

include conf/machine/include/amlogic_weston.inc
include conf/machine/include/amlogic_aiot_common.inc
include conf/machine/include/amlogic_aiot_nndemo.inc
include conf/machine/include/amlogic_enc_common.inc

PREFERRED_PROVIDER_virtual/mesa = "libgles-eabihf-dvalin-wayland-drm"
PREFERRED_PROVIDER_virtual/mesa-gl = "libgles-eabihf-dvalin-wayland-drm"
PREFERRED_PROVIDER_virtual/libgbm = "libgles-eabihf-dvalin-wayland-drm"
PREFERRED_PROVIDER_virtual/egl = "libgles-eabihf-dvalin-wayland-drm"
PREFERRED_PROVIDER_virtual/libgl = "libgles-eabihf-dvalin-wayland-drm"
PREFERRED_PROVIDER_virtual/libgles1 = "libgles-eabihf-dvalin-wayland-drm"
PREFERRED_PROVIDER_virtual/libgles2 = "libgles-eabihf-dvalin-wayland-drm"

MACHINE_ESSENTIAL_EXTRA_RRECOMMENDS += " \
        wififw-qca6174 \
        qca6174 \
        tuner-prebuilt \
        aucpu-fw \
        gpu \
        coreutils \
        "

CHIPSET_NAME = "S905X4"
PREFERRED_VERSION:qca6174 = "5.15"
RDEPENDS:packagegroup-amlogic-baserootfs:remove = "aml-subtitleserver"
RDEPENDS:packagegroup-amlogic-baserootfs:remove = " gst-aml-drm-plugins"
RDEPENDS:packagegroup-amlogic-baserootfs:remove = " fuse-exfat"
KERNEL_DEVICETREE = "sc2_s905x4_ah212_linux.dtb"
UBOOT_MACHINE = "sc2_ah212_config"
KERNEL_MODULE_AUTOLOAD += " cxd2856_fe_64"
KERNEL_MODULE_AUTOLOAD += " snd-soc-dummy_codec"
KERNEL_MODULE_AUTOLOAD += " snd-soc-aml_t9015"
KERNEL_MODULE_AUTOLOAD += " meson_ir"
KERNEL_MODULE_AUTOLOAD += " btqca"
KERNEL_MODULE_PROBECONF += "btqca"
KERNEL_MODULE_AUTOLOAD += " hci_uart"
KERNEL_MODULE_PROBECONF += "hci_uart"
KERNEL_MODULE_AUTOLOAD += "aml_aucpu"
KERNEL_MODULE_AUTOLOAD += "dolby_fw"
KERNEL_MODULE_AUTOLOAD += "meson-cpufreq"

DISTRO_FEATURES:append = " drm"
DISTRO_FEATURES:append = " gpt-partition"
DISTRO_FEATURES:append = " kernel_515"

DISTRO_FEATURES:append = " secure-u-boot optee "

DISTRO_FEATURES:append = " alsa "
DISTRO_FEATURES:append = " pam"
DISTRO_FEATURES_BACKFILL_CONSIDERED = "sysvinit"
DEFAULT_DISTRO_FEATURES += " systemd"
DISTRO_FEATURES:append = " systemd"
DISTRO_FEATURES:remove = " sysvinit"
DISTRO_FEATURES:append = " gstreamer1"
DISTRO_FEATURES:append = " aml-dtv "
DISTRO_FEATURES:append = " recovery "
DISTRO_FEATURES:append = " swupdate "
DISTRO_FEATURES:append = " aml-libjpeg "
DISTRO_FEATURES:append = " aml-libamvenc-264"
DISTRO_FEATURES:append = " aml-libamvenc-265"
DISTRO_FEATURES:append = " aml-libamvenc"
DISTRO_FEATURES:append = " gst-plugin-venc "
DISTRO_FEATURES:append = " mediactrlsrc"

OVERRIDES .= ":ah212:sc2:onepass"
MACHINEOVERRIDES .= ":client"

DISTRO_FEATURES:append = " bt-qca"
DISTRO_FEATURES:append = " bluetooth bluez5 "
EXTRA_BLUETOOTH_STUFF := "${@bb.utils.contains('DISTRO_FEATURES', 'bluetooth', bb.utils.contains('DISTRO_FEATURES', 'bluez5', ' bluez5', ' bluez4', d), '', d)}"
EXTRA_BLUETOOTH_STUFF += " bluez-alsa"
DISTRO_FEATURES:append = "${EXTRA_BLUETOOTH_STUFF}"
```

## conf/machine/mesonsm1-ac200-common.inc
```bitbake
#@TYPE: Machine
#@NAME: meson

#@DESCRIPTION: Machine configuration for meson systems

include conf/machine/include/amlogic_weston.inc
include conf/machine/include/amlogic_aiot_common.inc
include conf/machine/include/amlogic_aiot_nndemo.inc
include conf/machine/include/amlogic_enc_common.inc

PREFERRED_PROVIDER_virtual/mesa = "libgles-eabihf-dvalin-wayland-drm"
PREFERRED_PROVIDER_virtual/mesa-gl = "libgles-eabihf-dvalin-wayland-drm"
PREFERRED_PROVIDER_virtual/libgbm = "libgles-eabihf-dvalin-wayland-drm"
PREFERRED_PROVIDER_virtual/egl = "libgles-eabihf-dvalin-wayland-drm"
PREFERRED_PROVIDER_virtual/libgl = "libgles-eabihf-dvalin-wayland-drm"
PREFERRED_PROVIDER_virtual/libgles1 = "libgles-eabihf-dvalin-wayland-drm"
PREFERRED_PROVIDER_virtual/libgles2 = "libgles-eabihf-dvalin-wayland-drm"

MACHINE_EXTRA_RRECOMMENDS += " \
        gpu \
        wififw-ap6398 \
        ap6xxx \
        npu \
        coreutils \
        "

RDEPENDS:packagegroup-amlogic-baserootfs:remove = " aml-subtitleserver"
RDEPENDS:packagegroup-amlogic-baserootfs:remove = " gst-aml-drm-plugins"
RDEPENDS:packagegroup-amlogic-baserootfs:remove = " gst-agmplayer"
RDEPENDS:packagegroup-amlogic-baserootfs:remove = " fuse-exfat"
RDEPENDS:packagegroup-amlogic-baserootfs:append = " npu-common"

CHIPSET_NAME = "S905D3"
KERNEL_DEVICETREE = "sm1_s905d3_ac200_linux.dtb"
UBOOT_MACHINE = " sm1_ac200_v1_config"
KERNEL_MODULE_AUTOLOAD += " dhd"
KERNEL_MODULE_PROBECONF += "dhd"
module_conf_dhd = "options dhd firmware_path=../../etc/wifi/6398/ nvram_path=../../etc/wifi/6398/"
KERNEL_MODULE_AUTOLOAD += " snd-soc-dummy_codec"
KERNEL_MODULE_AUTOLOAD += " snd-soc-aml_t9015"
KERNEL_MODULE_AUTOLOAD += " snd-soc-tas5707"
KERNEL_MODULE_AUTOLOAD += " snd-soc-aml_codec_tl1_acodec"
KERNEL_MODULE_AUTOLOAD += " meson_ir"
KERNEL_MODULE_AUTOLOAD += " hci_uart"
KERNEL_MODULE_PROBECONF += "hci_uart"
KERNEL_MODULE_AUTOLOAD += "meson-cpufreq"

DISTRO_FEATURES:append = " drm"

DISTRO_FEATURES:append = " secure-u-boot optee "
DISTRO_FEATURES:append = " alsa "
DISTRO_FEATURES:append = " pam"
DISTRO_FEATURES_BACKFILL_CONSIDERED = "sysvinit"
DEFAULT_DISTRO_FEATURES += " systemd"
DISTRO_FEATURES:append = " systemd"
DISTRO_FEATURES:remove = " sysvinit"
DISTRO_FEATURES:append = " gstreamer1"
DISTRO_FEATURES:append = " aml-dtv "
DISTRO_FEATURES:append = " gst-plugin-venc"
DISTRO_FEATURES:append = " aml-libjpeg"
DISTRO_FEATURES:append = " aml-libamvenc-264"
DISTRO_FEATURES:append = " aml-libamvenc-265"
DISTRO_FEATURES:append = " aml-libamvenc"
DISTRO_FEATURES:append = " softap"
DISTRO_FEATURES:append = " aml-libgdc"
DISTRO_FEATURES:append = " swupdate"
DISTRO_FEATURES:append = " recovery"

DISTRO_FEATURES:append = " mediactrlsrc"

MACHINEOVERRIDES .= ":client"

DISTRO_FEATURES:append = " bt-bcm"
EXTRA_BLUETOOTH_STUFF := "${@bb.utils.contains('DISTRO_FEATURES', 'bluetooth', bb.utils.contains('DISTRO_FEATURES', 'bluez5', ' bluez5', ' bluez4', d), '', d)}"
EXTRA_BLUETOOTH_STUFF += " bluez-alsa"
EXTRA_BLUETOOTH_STUFF += " brcm-patchram-plus"
DISTRO_FEATURES:append = "${EXTRA_BLUETOOTH_STUFF}"
```

## conf/machine/mesonsm1-ac200-k5.15.conf
```bitbake
include conf/machine/include/mesonsm1_k5.15_64b.inc
include conf/machine/mesonsm1-ac200-common.inc
```

## conf/machine/mesonsm1-ac200-k6.6.conf
```bitbake
require conf/machine/include/mesonsm1_k6.6_64b.inc
require conf/machine/mesonsm1-ac200-common.inc
```
